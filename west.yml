## west.yml
```yaml
manifest: 
  remotes:
    - name: zephyrproject-rtos
      url-base: https://github.com/zephyrproject-rtos
    - name: personal
      url-base: git@github.com:Dvader30 
  defaults:
    remote: personal
  projects:
    - name: zephyr
      remote: zephyrproject-rtos
      revision: v4.4.0
      import: true
    - name: satcomms-ocs-rf-1.0.git
      revision: main
  self:
    path: man-repo
```
